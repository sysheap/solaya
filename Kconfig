## Kconfig
```kconfig
# Solaya Kernel Configuration
#
# Root Kconfig. Today only the target architecture is configurable; other
# knobs were removed because no Rust code consumed them. Run
# `cmake --build build --target menuconfig` to configure interactively, or
# copy a defconfig from configs/ as a starting point.

mainmenu "Solaya Kernel Configuration"

choice
	prompt "Target architecture"
	default ARCH_RISCV64
	help
	  Select the target architecture. Only RISC-V 64 is implemented
	  today.

config ARCH_RISCV64
	bool "RISC-V 64-bit"

endchoice

config ARCH
	string
	default "riscv64" if ARCH_RISCV64
```

## arch/Kconfig
```kconfig
menu "Architecture options"

if ARCH_RISCV64

config RISCV_DETECT_SECONDARY_HARTS
	bool "Detect and start secondary harts via SBI"
	default y
	help
	  Scan the FDT for supervisor-capable harts and bring them up via
	  SBI HART_START. Required for SMP; disable only for uniprocessor
	  debugging.

endif

endmenu
```

## configs/riscv64_virt_defconfig
```kconfig
# Solaya default configuration for the QEMU virt machine, RISC-V 64.
#
# All omitted options take their Kconfig-declared defaults. Regenerate with
# `cmake --build build --target savedefconfig` after `menuconfig`.

CONFIG_ARCH_RISCV64=y
```

## crates/kernel/Kconfig
```kconfig
menu "Kernel subsystems"

config SMP
	bool "Symmetric multiprocessing"
	default y
	help
	  Enables multi-hart scheduling. When disabled, only hart 0 runs.

config SMP_MAX_CPUS
	int "Maximum CPUs"
	depends on SMP
	range 1 64
	default 8

config NET
	bool "Network stack"
	default y
	help
	  Enables the UDP/TCP stack and virtio-net driver.

config FB
	bool "Framebuffer (bochs-display)"
	default n
	help
	  Enables framebuffer output. With FB off, all kernel output goes
	  through the UART.

endmenu

menu "Logging and debugging"

config LOG_DEFAULT_LEVEL
	int "Default log level (0=off, 1=warn, 2=info, 3=debug, 4=trace)"
	range 0 4
	default 2

config LOG_MODULES
	string "Extra modules to force-enable debug logging (comma-separated)"
	default ""
	help
	  Comma-separated list of module paths whose debug! calls should be
	  printed regardless of the default log level, e.g.
	  "kernel::processes::scheduler,kernel::net::tcp".

config DEBUG_ASSERTIONS
	bool "Runtime debug assertions"
	default y
	help
	  Enables debug_assert! and overflow checks in release builds.

endmenu
```

## userspace/Kconfig
```kconfig
menu "Userspace programs"

config USERSPACE_DOOM
	bool "Include Doom in userspace image"
	default y
	help
	  Adds the compiled Doom binary to the userspace artifact set.
	  Only useful at runtime when FB is also enabled.

endmenu
```
